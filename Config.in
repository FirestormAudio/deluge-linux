## Config.in
```kconfig
menu "Deluge packages"
	source "$BR2_EXTERNAL_DELUGE_PATH/package/deluge-alsa-static/Config.in"
	source "$BR2_EXTERNAL_DELUGE_PATH/package/deluge-launcher/Config.in"
	source "$BR2_EXTERNAL_DELUGE_PATH/package/deluge-splash/Config.in"
	source "$BR2_EXTERNAL_DELUGE_PATH/package/libdeluge/Config.in"
endmenu
```

## board/synthstrom/deluge/uboot/board/renesas/deluge/Kconfig
```kconfig
if TARGET_DELUGE

config SYS_BOARD
	default "deluge"

config SYS_VENDOR
	default "renesas"

config SYS_SOC
	default "r7s72100"

config SYS_CONFIG_NAME
	default "deluge"

endif
```

## package/deluge-alsa-static/Config.in
```kconfig
config BR2_PACKAGE_DELUGE_ALSA_STATIC
	bool "deluge-alsa-static"
	depends on BR2_PACKAGE_ALSA_LIB
	help
	  A static-only second build of alsa-lib whose libasound.a is installed
	  into the staging sysroot ONLY (never the target rootfs). It lets the SDK
	  statically link libasound into apps, which run from the SD card and must
	  not depend on any particular image's rootfs.

	  Buildroot's alsa-lib builds shared OR static, not both (its configure.ac
	  refuses "static and shared libraries together"), and every rootfs needs
	  the shared libasound.so — so this provides the .a alongside it. Headers,
	  alsa.pc and /usr/share/alsa come from the shared alsa-lib package.
```

## package/deluge-launcher/Config.in
```kconfig
config BR2_PACKAGE_DELUGE_LAUNCHER
	bool "deluge-launcher"
	depends on BR2_PACKAGE_HOST_RUSTC_TARGET_ARCH_SUPPORTS
	depends on BR2_PACKAGE_ALSA_LIB
	select BR2_PACKAGE_HOST_RUSTC
	select BR2_PACKAGE_LIBDELUGE
	help
	  The platform image's app launcher, installed as the app slot
	  (/usr/bin/deluge-app). It lists the ARM executables in the SD card's
	  /LINUX/APPS/ on the OLED, runs the one you pick, and returns to the
	  list when it exits or when SHIFT+TRIPLETS+LEARN is held for a second.
	  Each app's output goes to /LINUX/log/<app>.log. Enable it in the
	  platform profile only: base is for single-app images.

	  GPL-3.0-or-later (it uses deluge-sdk's GPL UI toolkit and fonts).
```

## package/deluge-splash/Config.in
```kconfig
config BR2_PACKAGE_DELUGE_SPLASH
	bool "deluge-splash"
	help
	  Boot splash for the Deluge OLED: renders the deluge/linux wordmark,
	  a progress bar and the kernel version during boot, driven by /init.

	  Built from in-tree source under package/deluge-splash/splash (no
	  fetch). /init guards on [ -x /usr/bin/splash ], so an image built
	  without this package still boots — just with no splash.

if BR2_PACKAGE_DELUGE_SPLASH

config BR2_PACKAGE_DELUGE_SPLASH_NAME
	string "splash display name"
	default "deluge/linux"
	help
	  The name shown on the boot splash. Rendered with the 8x8 font, so
	  keep it short enough to fit the 128px-wide OLED (~16 chars).

endif
```

## package/libdeluge/Config.in
```kconfig
config BR2_PACKAGE_LIBDELUGE
	bool "libdeluge"
	depends on BR2_PACKAGE_ALSA_LIB
	help
	  The Deluge userspace C library (libdeluge): libdeluge.a + public headers
	  + deluge.pc, installed into the staging sysroot ONLY (never the target
	  rootfs). Apps statically link it; it ships in the SDK sysroot the base
	  bundle publishes, which is how C/C++ and Rust apps build against it.
```
